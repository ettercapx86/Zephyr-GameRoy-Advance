## boards/shields/game_roy_advance/Kconfig.shield
```kconfig
config SHIELD_GAME_ROY_ADVANCE_LEFT
	def_bool $(shields_list_contains,game_roy_advance_left)

config SHIELD_GAME_ROY_ADVANCE_RIGHT
	def_bool $(shields_list_contains,game_roy_advance_right)
```
